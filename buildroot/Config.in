## buildroot/Config.in
```kconfig
# Buildroot external tree Config.in for Custom CUDA Linux Distribution

menu "NVIDIA/CUDA Custom Distribution Packages"
	source "$BR2_EXTERNAL_CUDA_DISTRO_PATH/package/cuda-nvidia-driver/Config.in"
	source "$BR2_EXTERNAL_CUDA_DISTRO_PATH/package/cuda-runtime/Config.in"
	source "$BR2_EXTERNAL_CUDA_DISTRO_PATH/package/cudnn-runtime/Config.in"
	source "$BR2_EXTERNAL_CUDA_DISTRO_PATH/package/cublas-runtime/Config.in"
	source "$BR2_EXTERNAL_CUDA_DISTRO_PATH/package/nvrtc-runtime/Config.in"
endmenu
```

## buildroot/configs/cuda_distro_defconfig
```kconfig
# Buildroot defconfig for Custom CUDA Linux Distribution
# Target: x86_64, OpenRC, glibc, ext4 rootfs

#
# Target Architecture
#
BR2_x86_64=y
BR2_x86_opteron=y

#
# Toolchain
#
BR2_TOOLCHAIN_BUILDROOT=y
BR2_TOOLCHAIN_BUILDROOT_GLIBC=y
BR2_TOOLCHAIN_BUILDROOT_CXX=y
BR2_USE_WCHAR=y
BR2_ENABLE_LOCALE=y
BR2_INSTALL_LIBSTDCPP=y

#
# System configuration
#
BR2_TARGET_GENERIC_HOSTNAME="cuda-distro"
BR2_TARGET_GENERIC_ISSUE="Welcome to CUDA Linux Distribution"
BR2_TARGET_GENERIC_PASSWD_SHA256=y
BR2_TARGET_GENERIC_ROOT_PASSWD="*"
BR2_SYSTEM_DHCP="eth0"

#
# Init system â€” OpenRC
#
BR2_INIT_OPENRC=y
BR2_PACKAGE_OPENRC=y

#
# Kernel
#
BR2_LINUX_KERNEL=y
BR2_LINUX_KERNEL_USE_CUSTOM_CONFIG=y
BR2_LINUX_KERNEL_BZIMAGE=y
BR2_LINUX_KERNEL_CUSTOM_CONFIG_FILE="$(BR2_EXTERNAL_CUDA_DISTRO_PATH)/../kernel/linux.config"
BR2_LINUX_KERNEL_CONFIG_FRAGMENT_FILES=""
BR2_LINUX_KERNEL_INSTALL_TARGET=y

#
# Filesystem images
#
BR2_TARGET_ROOTFS_EXT2=y
BR2_TARGET_ROOTFS_EXT2_4=y
BR2_TARGET_ROOTFS_EXT2_SIZE="4G"
BR2_TARGET_ROOTFS_EXT2_LABEL="cuda-rootfs"
BR2_TARGET_ROOTFS_EXT2_MKFS_OPTIONS="-O ^64bit"
BR2_TARGET_ROOTFS_TAR=y

#
# Root filesystem overlay
#
BR2_ROOTFS_OVERLAY="$(BR2_EXTERNAL_CUDA_DISTRO_PATH)/board/cuda-distro/rootfs-overlay"

#
# Post-build / post-image hooks
#
BR2_ROOTFS_POST_BUILD_SCRIPT="$(BR2_EXTERNAL_CUDA_DISTRO_PATH)/board/cuda-distro/post-build.sh"
BR2_ROOTFS_POST_IMAGE_SCRIPT="$(BR2_EXTERNAL_CUDA_DISTRO_PATH)/board/cuda-distro/post-image.sh"
BR2_ROOTFS_POST_SCRIPT_ARGS=""

#
# Packages â€” base system utilities
#
BR2_PACKAGE_BUSYBOX=y
BR2_PACKAGE_UTIL_LINUX=y
BR2_PACKAGE_UTIL_LINUX_BINARIES=y
BR2_PACKAGE_UTIL_LINUX_LIBBLKID=y
BR2_PACKAGE_UTIL_LINUX_LIBMOUNT=y
BR2_PACKAGE_UTIL_LINUX_LIBUUID=y
BR2_PACKAGE_E2FSPROGS=y
BR2_PACKAGE_E2FSPROGS_RESIZE2FS=y
BR2_PACKAGE_DOSFSTOOLS=y
BR2_PACKAGE_KMOD=y
BR2_PACKAGE_EUDEV=y

#
# Packages â€” network
#
BR2_PACKAGE_IFUPDOWN_SCRIPTS=y
BR2_PACKAGE_IPROUTE2=y
BR2_PACKAGE_IPUTILS=y
BR2_PACKAGE_WGET=y
BR2_PACKAGE_LIBCURL=y
BR2_PACKAGE_LIBCURL_CURL=y

#
# Packages â€” Python
#
BR2_PACKAGE_PYTHON3=y

#
# Packages â€” compression / archive
#
BR2_PACKAGE_XZ=y
BR2_PACKAGE_ZSTD=y
BR2_PACKAGE_ZLIB=y
BR2_PACKAGE_BZIP2=y

#
# Packages â€” hardware / GPU support
#
BR2_PACKAGE_CUDA_NVIDIA_DRIVER=y
BR2_PACKAGE_CUDA_RUNTIME=y
BR2_PACKAGE_CUDNN_RUNTIME=y

#
# Packages â€” security & container utilities
#
BR2_PACKAGE_LIBCAP_NG=y
BR2_PACKAGE_CA_CERTIFICATES=y

#
# Packages â€” debugging / profiling
#

#
# Bootloader â€” GRUB2
#
BR2_TARGET_GRUB2=y
BR2_TARGET_GRUB2_X86_64_EFI=y
BR2_TARGET_GRUB2_BUILTIN_MODULES_EFI="boot linux ext2 fat part_gpt normal search search_label serial terminal"

#
# Strip / optimization
#
BR2_STRIP_strip=y
BR2_OPTIMIZE_2=y

# Explicit pins matched to Buildroot 2024.02 and previous build evidence.
BR2_GCC_VERSION_12_X=y
BR2_LINUX_KERNEL_CUSTOM_VERSION=y
BR2_LINUX_KERNEL_CUSTOM_VERSION_VALUE="6.6.18"
BR2_LINUX_KERNEL_NEEDS_HOST_LIBELF=y
BR2_ROOTFS_DEVICE_CREATION_DYNAMIC_EUDEV=y
BR2_TARGET_GENERIC_GETTY=y
BR2_TARGET_GENERIC_GETTY_PORT="ttyS0"
BR2_TARGET_GENERIC_GETTY_BAUDRATE_115200=y
BR2_TARGET_GENERIC_REMOUNT_ROOTFS_RW=n
BR2_PACKAGE_HOST_GENIMAGE=y
BR2_PACKAGE_HOST_DOSFSTOOLS=y
BR2_PACKAGE_HOST_MTOOLS=y
BR2_PACKAGE_RUNC=y
```

## buildroot/package/cublas-runtime/Config.in
```kconfig
config BR2_PACKAGE_CUBLAS_RUNTIME
	bool "cublas-runtime"
	depends on BR2_x86_64
	depends on BR2_TOOLCHAIN_USES_GLIBC
```

## buildroot/package/cuda-nvidia-driver/Config.in
```kconfig
config BR2_PACKAGE_CUDA_NVIDIA_DRIVER
	bool "cuda-nvidia-driver (headless compute)"
	depends on BR2_TOOLCHAIN_USES_GLIBC
	depends on BR2_x86_64
	depends on BR2_LINUX_KERNEL
	depends on !BR2_PACKAGE_NVIDIA_DRIVER
	help
	  Installs the NVIDIA proprietary graphics/compute driver
	  (version 550.127.05) including the kernel modules (nvidia,
	  nvidia-modeset, nvidia-uvm, nvidia-drm) and userspace libraries
	  (libcuda, PTX JIT libraries, libnvidia-ml, nvidia-smi).

	  This package is required for CUDA compute workloads.

	  https://www.nvidia.com/drivers

comment "nvidia-driver needs a Linux kernel to be built"
	depends on BR2_x86_64
	depends on !BR2_LINUX_KERNEL
```

## buildroot/package/cuda-runtime/Config.in
```kconfig
config BR2_PACKAGE_CUDA_RUNTIME
	bool "cuda-runtime"
	depends on BR2_TOOLCHAIN_USES_GLIBC
	depends on BR2_x86_64
	depends on BR2_PACKAGE_CUDA_NVIDIA_DRIVER
	help
	  Installs the CUDA 12.4 runtime shared libraries (libcudart) on the
	  target.  This is the minimal runtime needed to execute pre-compiled
	  CUDA applications.  The CUDA compiler (nvcc) and SDK headers are
	  NOT included; this package is for deployment targets only.

	  Depends on the nvidia-driver package to provide libcuda.so.

	  https://developer.nvidia.com/cuda-toolkit

comment "cuda-runtime needs nvidia-driver and an x86_64 target"
	depends on !BR2_x86_64 || !BR2_PACKAGE_CUDA_NVIDIA_DRIVER
```

## buildroot/package/cudnn-runtime/Config.in
```kconfig
config BR2_PACKAGE_CUDNN_RUNTIME
	bool "cudnn-runtime"
	depends on BR2_TOOLCHAIN_USES_GLIBC
	depends on BR2_x86_64
	depends on BR2_PACKAGE_CUDA_RUNTIME
	select BR2_PACKAGE_CUBLAS_RUNTIME
	select BR2_PACKAGE_NVRTC_RUNTIME
	help
	  Installs the NVIDIA cuDNN 9.x runtime shared libraries on the
	  target.  cuDNN is a GPU-accelerated library of primitives for
	  deep neural networks (convolutions, pooling, normalization,
	  activation layers, etc.).

	  Only the runtime .so files are installed — no development headers
	  or static libraries.  Applications that were compiled against
	  cuDNN headers on the host will find the matching runtime here.

	  Requires cuda-runtime (libcudart) and nvidia-driver (libcuda).

	  https://developer.nvidia.com/cudnn

comment "cudnn-runtime needs cuda-runtime and an x86_64 target"
	depends on !BR2_x86_64 || !BR2_PACKAGE_CUDA_RUNTIME
```

## buildroot/package/nvrtc-runtime/Config.in
```kconfig
config BR2_PACKAGE_NVRTC_RUNTIME
	bool "nvrtc-runtime"
	depends on BR2_x86_64
	depends on BR2_TOOLCHAIN_USES_GLIBC
```
